#include <Wire.h>
#include <Adafruit_GFX.h>
#include <Adafruit_SSD1306.h>
#include <DHT.h>
#include <WiFi.h>  
#include <PubSubClient.h>
#include <ArduinoJson.h>


#define SCREEN_WIDTH 128
#define SCREEN_HEIGHT 64
Adafruit_SSD1306 display(SCREEN_WIDTH, SCREEN_HEIGHT, &Wire);


// ตั้งค่า WiFi
const char* ssid = "Wokwi-GUEST";
const char* password = "";

// ตั้งค่า MQTT (ThingsBoard)
const char* mqtt_server = "demo.thingsboard.io"; 
const char* access_token = "VwH6CjFADOUK2AVi2PhF";
const int ledpin = 25;

WiFiClient espClient;
PubSubClient client(espClient);

#define DHTPIN 15
#define DHTTYPE DHT22
DHT dht(DHTPIN, DHTTYPE);

#define BTN_UP 12
#define BTN_DOWN 14
#define BTN_SELECT 27
#define BTN_BACK 26

// ฟังก์ชัน callback ที่แก้ไขแล้ว
void callback(char* topic, byte* payload, unsigned int length) {
  // แปลง payload เป็น string
  char message[length + 1];
  memcpy(message, payload, length);
  message[length] = '\0';
  
  Serial.print("Received [");
  Serial.print(topic);
  Serial.print("]: ");
  Serial.println(message);

  // แปลง JSON
  JsonDocument doc;
  DeserializationError error = deserializeJson(doc, message);
  
  if (error) {
    Serial.print("JSON parse error: ");
    Serial.println(error.c_str());
    return;
  }

  // ตรวจสอบ method โดยตัดช่องว่างออก
  String method = doc["method"].as<String>();
  method.trim();
  
  if (method != "led") {
    Serial.println("Not a LED command");
    return;
  }

  // ตรวจสอบ params ในรูปแบบต่างๆ
  bool ledState = false;
  
  if (doc["params"].is<bool>()) {
    ledState = doc["params"];
  } 
  else if (doc["params"].is<const char*>()) {
    const char* param = doc["params"];
    if (strcasecmp(param, "ON") == 0 || strcasecmp(param, "TRUE") == 0 || strcmp(param, "1") == 0) {
      ledState = true;
    }
  }
  else if (doc["params"].isNull()) {
    ledState = !digitalRead(ledpin);
  }

  // ควบคุม LED
  digitalWrite(ledpin, ledState ? HIGH : LOW);
  Serial.print("LED set to: ");
  Serial.println(ledState ? "ON" : "OFF");  // แก้ไขจาก ledpin เป็น ledState

  // ส่ง response กลับ
  char response[50];
  snprintf(response, sizeof(response), "{\"led\":%s}", ledState ? "true" : "false");
  client.publish("v1/devices/me/attributes", response);

  // ตอบกลับ RPC request
  if (doc["id"]) {
    char rpcResponse[100];
    snprintf(rpcResponse, sizeof(rpcResponse), 
             "{\"method\":\"led\",\"params\":%s,\"id\":\"%s\"}", 
             ledState ? "true" : "false", 
             doc["id"].as<const char*>());
             
    String responseTopic(topic);
    responseTopic.replace("request", "response");
    client.publish(responseTopic.c_str(), rpcResponse);
  }
}




enum Mode { MAIN_MENU, SWITCHED_MENU, SENSOR_DISPLAY };
Mode mode = MAIN_MENU;

int menu_index = 0;
int menu_start = 0;
const int menu_items = 10;
const int display_items = 3;

bool isMenuSwitched = false;

String main_menu[] = {"Menu 1", "Menu 2", "Menu 3", "Menu 4", "Menu 5", 
                      "Menu 6", "Menu 7", "Menu 8", "Menu 9", "Menu 10"};

String switched_menu[] = {"Menu 1", "Temp", "Humid", "Menu 4", "Menu 5", 
                          "Menu 6", "Menu 7", "Menu 8", "Menu 9", "Menu 10"};


// ไอคอนอุณหภูมิ (Temp) 
const unsigned char temp_icon[] PROGMEM = {
  0x00, 0x00, 0x00, 0x00, 0x00, 0x00, 0x00, 0x00, 0x00, 0x00, 0x00, 0x00, 0x00, 0x00, 0x00, 0x00, 
	0x00, 0x00, 0x00, 0x00, 0x00, 0x00, 0x00, 0x00, 0x00, 0x00, 0x00, 0x00, 0x00, 0x00, 0x00, 0x00, 
	0x00, 0x00, 0x00, 0x00, 0x00, 0x00, 0x00, 0x00, 0x00, 0x00, 0x00, 0x00, 0x00, 0x00, 0x00, 0x00, 
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	0x00, 0x00, 0x00, 0x00, 0x00, 0x00, 0x00, 0x00, 0x00, 0x00, 0x00, 0x00, 0x00, 0x00, 0x00, 0x00
};

// ไอคอนความชื้น (Humid) 
const unsigned char humid_icon[] PROGMEM = {
  0x00, 0x00, 0x00, 0x00, 0x00, 0x00, 0x00, 0x00, 0x00, 0x00, 0x00, 0x00, 0x00, 0x00, 0x00, 0x00, 
	0x00, 0x00, 0x00, 0x00, 0x00, 0x00, 0x00, 0x00, 0x00, 0x00, 0x00, 0x00, 0x00, 0x00, 0x00, 0x00, 
	0x00, 0x00, 0x00, 0x00, 0x00, 0x00, 0x00, 0x00, 0x00, 0x00, 0x00, 0x00, 0x00, 0x00, 0x00, 0x00, 
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	0x00, 0x00, 0x00, 0x00, 0x00, 0x00, 0x00, 0x00, 0x00, 0x00, 0x00, 0x00, 0x00, 0x00, 0x00, 0x00
};


void displayMenu() {
  display.clearDisplay();
  display.setTextSize(2);
  display.setTextColor(WHITE);

  for (int i = 0; i < display_items; i++) {
    int idx = menu_start + i;
    if (idx < menu_items) {
      int x = 10;
      int y = i * 20;

      String menuText = isMenuSwitched ? switched_menu[idx] : main_menu[idx];

      if (idx == menu_index) {
        display.drawRect(x - 5, y - 2, 100, 20, WHITE);  // วาดกรอบสี่เหลี่ยม
      }

      display.setCursor(x, y);
      display.println(menuText);
    }
  }
  display.display();
}

void displayValue(String title, float value, String unit, const uint8_t *icon) {
  display.clearDisplay();
  display.setTextSize(2);
  display.setTextColor(WHITE);

  // แสดงไอคอนที่ตำแหน่ง (10, 15)
  display.drawBitmap(-50, 13, icon, 128, 64, WHITE);

  // คำนวณตำแหน่งข้อความ
  int16_t x1, y1;
  uint16_t w, h;
  
  display.getTextBounds(title, 0, 0, &x1, &y1, &w, &h);
  int titleX = 40;  // ขยับข้อความไปทางขวา
  int titleY = 5;   // ขยับขึ้นเล็กน้อย

  // ข้อความที่จะแสดง 
  String valueText = String(value) + " " + unit;
  display.getTextBounds(valueText, 0, 0, &x1, &y1, &w, &h);
  int valueX = 40;   // ขยับข้อความไปทางขวา
  int valueY = 40;

  // แสดงข้อความที่ขวาของไอคอน
  display.setCursor(titleX, titleY);
  display.println(title);
  display.setCursor(valueX, valueY);
  display.println(valueText);
  display.display();
  
  // รอให้กดปุ่ม BACK ก่อนออก
  while (digitalRead(BTN_BACK) == HIGH);
  delay(200);
  mode = SWITCHED_MENU;
  displayMenu();
}

void reconnect() {
  while (!client.connected()) {
    Serial.print("Attempting MQTT connection...");
    
    if (client.connect("ESP32Client", access_token, "")) {
      Serial.println("connected");
      client.subscribe("v1/devices/me/rpc/request/+");
    } else {
      Serial.print("failed, rc=");
      Serial.print(client.state());
      Serial.println(" try again in 5 seconds");
      delay(5000);
    }
  }
}


void setup() {  
	Serial.begin(115200);
	pinMode(ledpin, OUTPUT);
	digitalWrite(ledpin, LOW);
  pinMode(BTN_UP, INPUT_PULLUP);
  pinMode(BTN_DOWN, INPUT_PULLUP);
  pinMode(BTN_SELECT, INPUT_PULLUP);
  pinMode(BTN_BACK, INPUT_PULLUP);
  
  dht.begin();
  display.begin(SSD1306_SWITCHCAPVCC, 0x3C);
  displayMenu();

  	   // เชื่อมต่อ WiFi
		 WiFi.begin(ssid, password);
		 while (WiFi.status() != WL_CONNECTED) {
			 delay(1000);
			 Serial.println("Connecting to WiFi...");
		 }
		 Serial.println("Connected to WiFi");
	 
		 // ตั้งค่า MQTT
		 client.setServer(mqtt_server, 1883);
		 client.setCallback(callback);
}



void loop() {
	float temp = dht.readTemperature();
	float humid = dht.readHumidity();


  if (mode == MAIN_MENU || mode == SWITCHED_MENU) {
    if (digitalRead(BTN_UP) == LOW) {
      if (menu_index > 0) {
        menu_index--; 
        if (menu_index < menu_start) {
          menu_start = menu_index;
        }
        displayMenu();
      }
      delay(200);
    }
    if (digitalRead(BTN_DOWN) == LOW) {
      if (menu_index < menu_items - 1) {
        menu_index++; 
        if (menu_index >= menu_start + display_items) {
          menu_start = menu_index - display_items + 1;
        }
        displayMenu();
      }
      delay(200);
    }
    if (digitalRead(BTN_SELECT) == LOW) {
      if (mode == MAIN_MENU && (menu_index == 1 || menu_index == 2)) {
        isMenuSwitched = true;  
        mode = SWITCHED_MENU;
      } else if (mode == SWITCHED_MENU) {
        if (menu_index == 1) {  // Temp
          displayValue("Temp", dht.readTemperature(), "C", temp_icon);
        } else if (menu_index == 2) {  // Humid
          displayValue("Humid", dht.readHumidity(), "%", humid_icon);
        }
      }
      displayMenu();
      delay(500);
    }
    if (digitalRead(BTN_BACK) == LOW) {
      isMenuSwitched = false;
      mode = MAIN_MENU;
      displayMenu();
      delay(200);
    }
  }


  	if (!client.connected()) {
	reconnect();
	}
  client.loop();

  static unsigned long lastSend = 0;
  if (millis() - lastSend > 5000) {
    String payload = "{\"temperature\":" + String(temp, 2) + ",\"humidity\":" + String(humid, 2) + "}";
    if (client.publish("v1/devices/me/telemetry", payload.c_str())) {
      Serial.println("Data sent to ThingsBoard");
    } else {
      Serial.println("Failed to send data");
    }
    lastSend = millis();
  }


}