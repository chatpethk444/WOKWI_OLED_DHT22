#include <Wire.h>
#include <Adafruit_GFX.h>
#include <Adafruit_SSD1306.h>
#include <DHT.h>
#include <WiFi.h>  
#include <PubSubClient.h>

#define LED 25
#define SCREEN_WIDTH 128
#define SCREEN_HEIGHT 64
Adafruit_SSD1306 display(SCREEN_WIDTH, SCREEN_HEIGHT, &Wire);


// ตั้งค่า WiFi
const char* ssid = "Wokwi-GUEST";
const char* password = "";

// ตั้งค่า MQTT (ThingsBoard)
const char* mqtt_server = "demo.thingsboard.io"; 
const char* access_token = "VwH6CjFADOUK2AVi2PhF";

WiFiClient espClient;
PubSubClient client(espClient);

#define DHTPIN 15
#define DHTTYPE DHT22
DHT dht(DHTPIN, DHTTYPE);

#define BTN_UP 12
#define BTN_DOWN 14
#define BTN_SELECT 27
#define BTN_BACK 26

enum Mode { MAIN_MENU, SWITCHED_MENU, SENSOR_DISPLAY };
Mode mode = MAIN_MENU;

int menu_index = 0;
int menu_start = 0;
const int menu_items = 10;
const int display_items = 3;

bool isMenuSwitched = false;

String main_menu[] = {"Menu 1", "Menu 2", "Menu 3", "Menu 4", "Menu 5", 
                      "Menu 6", "Menu 7", "Menu 8", "Menu 9", "Menu 10"};

String switched_menu[] = {"Menu 1", "Temp", "Humid", "Menu 4", "Menu 5", 
                          "Menu 6", "Menu 7", "Menu 8", "Menu 9", "Menu 10"};


// ไอคอนอุณหภูมิ (Temp) 
const unsigned char temp_icon[] PROGMEM = {
  0x00, 0x00, 0x00, 0x00, 0x00, 0x00, 0x00, 0x00, 0x00, 0x00, 0x00, 0x00, 0x00, 0x00, 0x00, 0x00, 
	0x00, 0x00, 0x00, 0x00, 0x00, 0x00, 0x00, 0x00, 0x00, 0x00, 0x00, 0x00, 0x00, 0x00, 0x00, 0x00, 
	0x00, 0x00, 0x00, 0x00, 0x00, 0x00, 0x00, 0x00, 0x00, 0x00, 0x00, 0x00, 0x00, 0x00, 0x00, 0x00, 
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	0x00, 0x00, 0x00, 0x00, 0x00, 0x00, 0x00, 0x00, 0x00, 0x00, 0x00, 0x00, 0x00, 0x00, 0x00, 0x00
};

// ไอคอนความชื้น (Humid) 
const unsigned char humid_icon[] PROGMEM = {
  0x00, 0x00, 0x00, 0x00, 0x00, 0x00, 0x00, 0x00, 0x00, 0x00, 0x00, 0x00, 0x00, 0x00, 0x00, 0x00, 
	0x00, 0x00, 0x00, 0x00, 0x00, 0x00, 0x00, 0x00, 0x00, 0x00, 0x00, 0x00, 0x00, 0x00, 0x00, 0x00, 
	0x00, 0x00, 0x00, 0x00, 0x00, 0x00, 0x00, 0x00, 0x00, 0x00, 0x00, 0x00, 0x00, 0x00, 0x00, 0x00, 
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	0x00, 0x00, 0x00, 0x00, 0x00, 0x00, 0x00, 0x00, 0x00, 0x00, 0x00, 0x00, 0x00, 0x00, 0x00, 0x00
};


void displayMenu() {
  display.clearDisplay();
  display.setTextSize(2);
  display.setTextColor(WHITE);

  for (int i = 0; i < display_items; i++) {
    int idx = menu_start + i;
    if (idx < menu_items) {
      int x = 10;
      int y = i * 20;

      String menuText = isMenuSwitched ? switched_menu[idx] : main_menu[idx];

      if (idx == menu_index) {
        display.drawRect(x - 5, y - 2, 100, 20, WHITE);  // วาดกรอบสี่เหลี่ยม
      }

      display.setCursor(x, y);
      display.println(menuText);
    }
  }
  display.display();
}

void displayValue(String title, float value, String unit, const uint8_t *icon) {
  display.clearDisplay();
  display.setTextSize(2);
  display.setTextColor(WHITE);

  // แสดงไอคอนที่ตำแหน่ง (10, 15)
  display.drawBitmap(-50, 13, icon, 128, 64, WHITE);

  // คำนวณตำแหน่งข้อความ
  int16_t x1, y1;
  uint16_t w, h;
  
  display.getTextBounds(title, 0, 0, &x1, &y1, &w, &h);
  int titleX = 40;  // ขยับข้อความไปทางขวา
  int titleY = 5;   // ขยับขึ้นเล็กน้อย

  // ข้อความที่จะแสดง 
  String valueText = String(value) + " " + unit;
  display.getTextBounds(valueText, 0, 0, &x1, &y1, &w, &h);
  int valueX = 40;   // ขยับข้อความไปทางขวา
  int valueY = 40;

  // แสดงข้อความที่ขวาของไอคอน
  display.setCursor(titleX, titleY);
  display.println(title);
  display.setCursor(valueX, valueY);
  display.println(valueText);
  display.display();
  
  // รอให้กดปุ่ม BACK ก่อนออก
  while (digitalRead(BTN_BACK) == HIGH);
  delay(200);
  mode = SWITCHED_MENU;
  displayMenu();
}


void setup() {  
	Serial.begin(115200);
	pinMode(LED, OUTPUT);
  pinMode(BTN_UP, INPUT_PULLUP);
  pinMode(BTN_DOWN, INPUT_PULLUP);
  pinMode(BTN_SELECT, INPUT_PULLUP);
  pinMode(BTN_BACK, INPUT_PULLUP);
  
  dht.begin();
  display.begin(SSD1306_SWITCHCAPVCC, 0x3C);
  displayMenu();

  	   // เชื่อมต่อ WiFi
		 WiFi.begin(ssid, password);
		 while (WiFi.status() != WL_CONNECTED) {
			 delay(1000);
			 Serial.println("Connecting to WiFi...");
		 }
		 Serial.println("Connected to WiFi");
	 
		 // ตั้งค่า MQTT
		 client.setServer(mqtt_server, 1883);

		 while (!client.connected()) {
			if (client.connect("ESP32", access_token, NULL)) {
				Serial.println("Connected to MQTT");

			} else {
				delay(5000);
			}
		}

}

void reconnect() {
    while (!client.connected()) {
        Serial.println("Connecting to MQTT...");
        if (client.connect("ESP32Client", access_token, "")) {
            Serial.println("Connected to MQTT!");
        } else {
            Serial.print("Failed, rc=");
            Serial.print(client.state());
            Serial.println(" Retrying in 5 seconds...");
            delay(5000);
        }
    }
}

void loop() {
	digitalWrite(LED, HIGH);

	float temp = dht.readTemperature();
	float humid = dht.readHumidity();


  if (mode == MAIN_MENU || mode == SWITCHED_MENU) {
    if (digitalRead(BTN_UP) == LOW) {
      if (menu_index > 0) {
        menu_index--; 
        if (menu_index < menu_start) {
          menu_start = menu_index;
        }
        displayMenu();
      }
      delay(200);
    }
    if (digitalRead(BTN_DOWN) == LOW) {
      if (menu_index < menu_items - 1) {
        menu_index++; 
        if (menu_index >= menu_start + display_items) {
          menu_start = menu_index - display_items + 1;
        }
        displayMenu();
      }
      delay(200);
    }
    if (digitalRead(BTN_SELECT) == LOW) {
      if (mode == MAIN_MENU && (menu_index == 1 || menu_index == 2)) {
        isMenuSwitched = true;  
        mode = SWITCHED_MENU;
      } else if (mode == SWITCHED_MENU) {
        if (menu_index == 1) {  // Temp
          displayValue("Temp", dht.readTemperature(), "C", temp_icon);
        } else if (menu_index == 2) {  // Humid
          displayValue("Humid", dht.readHumidity(), "%", humid_icon);
        }
      }
      displayMenu();
      delay(500);

	  
    }
    if (digitalRead(BTN_BACK) == LOW) {
      isMenuSwitched = false;
      mode = MAIN_MENU;
      displayMenu();
      delay(200);
    }
	if (!client.connected()) {
        reconnect();
    }


  }
    // ส่งข้อมูลไปยัง ThingsBoard
    String payload = "{\"temperature\": " + String(temp, 2) + ", \"humidity\": " + String(humid, 2) + "}"; 
    client.publish("v1/devices/me/telemetry", payload.c_str());
    client.loop();
}
